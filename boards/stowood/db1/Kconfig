## boards/stowood/db1/Kconfig
```kconfig
config BOARD_INIT_PRIORITY
	int "Board initialization priority"
	default 1
	help
	  Board initialization priority.
```

## boards/stowood/db1/Kconfig.db1
```kconfig
config BOARD_DB1
	select SOC_MCXN947_CPU0 if BOARD_DB1_MCXN947_CPU0 || BOARD_DB1_MCXN947_CPU0_QSPI
	select SOC_MCXN947_CPU1 if BOARD_DB1_MCXN947_CPU1
	select SOC_PART_NUMBER_MCXN947VDF

config BOARD_DB1_REV_62_2
	bool
	default y if BOARD_REVISION = "62.2.0" || BOARD_REVISION = "62.2.1"
	help
	  Enable features specific to board revision 62.2.X
```

## boards/stowood/db1/board.yml
```yaml
board:
  name: db1
  full_name: dev-board1
  vendor: nxp
  socs:
  - name: mcxn947
    variants:
    - name: qspi
      cpucluster: 'cpu0'
  revision:
    format: major.minor.patch
    default: 62.2.1
    exact: true
    revisions:
      - name: 62.2.0
      - name: 62.2.1
```

## drivers/Kconfig
```kconfig
menu "Drivers"
rsource "audio/Kconfig"
rsource "blink/Kconfig"
rsource "i2s/Kconfig"
rsource "sensor/Kconfig"
endmenu
```

## drivers/audio/Kconfig
```kconfig
config AUDIO_CODEC_MAX9867
	bool "MAX9867 audio codec driver"
	default y
	depends on AUDIO_CODEC && I2C
	help
	  Enable driver for MAX9867 audio codec.
```

## drivers/i2s/ads1298/Kconfig
```kconfig
config I2S_ADS1298
	bool "TI ADS1298 EXG I2S driver"
	depends on I2S && SPI && GPIO
	help
	  Enable driver for TI ADS1298 EXG (ECG/EEG) analog front-end
	  IC that presents data as an I2S-like stream.


config EXG_RX_SAMPLE_COUNT
    int "Number of samples to receive in one I2S transaction"
    default 32
#     range 1 256
    help
      This is the number of samples that?
#TODO
```

## drivers/sensor/Kconfig
```kconfig
if SENSOR
rsource "example_sensor/Kconfig"
rsource "abp2s/Kconfig"
#rsource "ads1298/Kconfig"
rsource "veml6030/Kconfig"
endif
```

## drivers/sensor/abp2s/Kconfig
```kconfig
menuconfig ABP2S
	bool "ABP2 SPI Pressure Sensor"
	default y
	depends on DT_HAS_HONEYWELL_ABP2S_ENABLED
	select SPI
	help
	  Enable the driver for Honeywell ABP2 pressure Sensors.

config ABP2_MIN_PRESSURE
	int "Minimum Pressure (milliPSI)"
	default 0
	range  -1000000 1000000
	help
	  The "10%" value in the datasheet that represents the minimum pressure.
	  It can be negative.

config ABP2_MAX_PRESSURE
    int "Maximum Pressure (milliPSI)"
    default 1000
    range  -1000000 1000000
    help
      The "90%" value in the datasheet that represents the maximum pressure.
      It can be negative.
```

## drivers/sensor/ads1298/Kconfig
```kconfig
menuconfig ADS1298
	bool "Enable ADS1298 driver"
	default y
	depends on DT_HAS_TI_ADS1298_ENABLED
	select SPI
	help
	  Enable the driver for TI ADS1298 ExG AFE
```

## drivers/sensor/veml6030/Kconfig
```kconfig
# Vishay VEML6030 ambient light sensor driver options.

config VEML6030
	bool "Vishay VEML6030 ambient light sensor"
	default y
	depends on DT_HAS_VISHAY_VEML6030_ENABLED
	select I2C
	help
	  Enable Vishay VEML6030 ambient light sensor driver.
```

## dts/bindings/audio/maxim,max9867.yaml
```yaml
description: Maxim MAX9867 Audio Codec

compatible: "maxim,max9867"

include: [i2c-device.yaml]

properties:
  clocks:
    required: true

  mclk-default:
#   required: true
    type: int
    default: 12288000
    description: Master clock rate in Hz
```

## dts/bindings/i2s/ti,ads1298_i2s.yaml
```yaml
description: |
  Texas Instruments ADS1298 8-channel, 24-bit analog-to-digital converter
  with integrated programmable gain amplifier and internal reference.

compatible: "ti,ads1298_i2s"

include: [sensor-device.yaml, spi-device.yaml]

properties:
  int-gpios:
    type: phandle-array
    description: |
      The INT signal defaults to active low open drain, so requires a
      pull-up on the board or in the flags cell of this entry.

  clksel-gpios:
    type: phandle-array
    description: |
      GPIO pin for clock select signal (CLKSEL).
      High = internal clock, Low = external clock.

  nrst-gpios:
    type: phandle-array
    description: |
      GPIO pin for reset signal (nRST).
      Active low reset pin.

  npwdn-gpios:
    type: phandle-array
    description: |
      GPIO pin for power down signal (nPWDN).
      Active low power down pin.

  start-conv-gpios:
    type: phandle-array
    description: |
      GPIO pin for start conversion signal (START).
      High = start conversions, Low = stop conversions.

  drdy-gpios:
    type: phandle-array
    description: |
      GPIO pin for data ready signal (DRDY).
      Goes low when new data is available.

  sample-rate:
    type: int
    default: 250
    description: |
      Sample rate in Hz. Supported rates: 250, 500, 1000, 2000, 4000, 8000, 16000, 32000.

  channels:
    type: int
    default: 8
    description: |
      Number of channels to enable (1-8).
```

## dts/bindings/sensor/honeywell,abp2s.yaml
```yaml
description: High Accuracy, Compensated/Amplified Pressure sensor

compatible: "honeywell,abp2s"

include: [sensor-device.yaml, spi-device.yaml]

properties:
  min-pressure-millipsi:
    type: int
    default: 0
    description: |
      The "10%" value in the datasheet that represents the minimum pressure.
      It can be negative. Value is in milliPSI (1/1000 PSI).
  max-pressure-millipsi:
    type: int
    default: 1000
    description: |
      The "90%" value in the datasheet that represents the maximum pressure.
      It can be negative. Value is in milliPSI (1/1000 PSI).
```

## dts/bindings/sensor/ti,ads1298.yaml
```yaml
description: |
  Texas Instruments ADS1298 8-channel, 24-bit analog-to-digital converter
  with integrated programmable gain amplifier and internal reference.

compatible: "ti,ads1298"

include: [sensor-device.yaml, spi-device.yaml]

properties:
  int-gpios:
    type: phandle-array
    description: |
      The INT signal defaults to active low open drain, so requires a
      pull-up on the board or in the flags cell of this entry.
```

## dts/bindings/sensor/vishay,veml6030.yaml
```yaml
description: |
    Vishay VEML6030 Ambient Light Sensor With I2C Interface.

compatible: "vishay,veml6030"

include: [sensor-device.yaml, i2c-device.yaml]

properties:
#  int-gpios:
#    type: phandle-array
#    description: |
#      The INT signal defaults to active low open drain, so requires a
#      pull-up on the board or in the flags cell of this entry.
  psm-mode:
    type: int
    default: 0x00
    description: |
      Power saving mode as described in the datasheet on page 8.
      The initial power on register value for the PSM register is 0
      (power saving mode is disabled) which is the default value.
      Possible values are:
        0x00 = Disable power saving mode
        0x01 = Mode 1 (0001b)
        0x03 = Mode 2 (0011b)
        0x05 = Mode 3 (0101b)
        0x07 = Mode 4 (0111b)
    enum:
      - 0x00
      - 0x01
      - 0x03
      - 0x05
      - 0x07
```

## tests/codec_integration/testcase.yaml
```yaml
common:
  tags: extensibility
  integration_platforms:
    - custom_plank
    - qemu_cortex_m3
    - native_posix
    - native_sim
    - qemu_x86
tests:
  pressure_status.test_no_responce: {}
```

## tests/exg/testcase.yaml
```yaml
common:
  tags: exg
  integration_platforms:
    - custom_plank
    - qemu_cortex_m3
    - native_posix
    - native_sim
    - qemu_x86
tests:
  exg.test_settling_times: {}
```

## tests/pressure_sensor/testcase.yaml
```yaml
common:
  tags: extensibility
  integration_platforms:
    - custom_plank
    - qemu_cortex_m0
tests:
  pressure_status.test_no_responce: {}
```

## west.yml
```yaml
manifest:
  self:
    west-commands: scripts/west-commands.yml

  # Override Zephyr's group filter to include nanopb (which is in the optional group)
  group-filter: [-babblesim, +optional]

  remotes:
    - name: zephyrproject-rtos
      url-base: https://github.com/zephyrproject-rtos
    - name: stowood
      url-base: git@github.com:Stowood
      
  projects:
    - name: zephyr
      remote: zephyrproject-rtos
      revision: v4.1.0
      import:
        name-allowlist:
          - cmsis      # required by the ARM port
          - hal_nxp
          - hal_st
          - fatfs
          - littlefs
          - nanopb

    - name: bfp_common_sw
      remote: stowood
      revision: file_rev_4
      path: bfp_common_sw
```
